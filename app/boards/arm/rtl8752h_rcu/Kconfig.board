## app/boards/arm/rtl8752h_rcu/Kconfig.board
```kconfig
config BOARD_RTL8762GN_EVB
    bool "RealTek rtl8752h rcu board"
    depends on SOC_SERIES_RTL8752H
    select SOC_PART_NUMBER_RTL8762GN
```

## app/boards/arm/rtl8752htv_evb/Kconfig.defconfig
```kconfig
# Copyright (c) 2024 Realtek Semiconductor Corp.
# SPDX-License-Identifier: Apache-2.0
if BOARD_RTL8752HTV_EVB

config BOARD
	default "rtl8752htv_evb"

endif

if BT

config MAIN_STACK_SIZE
	default 2048

config COMMON_LIBC_MALLOC_ARENA_SIZE
	default 1024

# choice BT_HCI_BUS_TYPE
# 	default BT_RTL8752H
# endchoice

# choice BT_RECV_CONTEXT
# 	default BT_RECV_BLOCKING
# endchoice

config BT_CTLR
	default n

config REALTEK_BT
	default y

config BT_L2CAP_TX_MTU
	default 247

config BT_BUF_EVT_RX_COUNT
	default 8

config BT_BUF_EVT_RX_SIZE
	default 255

config BT_BUF_ACL_TX_SIZE
	default 251

config BT_BUF_ACL_RX_SIZE
	default 255

config BT_BUF_ACL_RX_COUNT
	default 7

config REALTEK_BT_CONTROLLER_STACK_SIZE
	default 2560

endif # BT
```

## app/boards/arm/rtl8752htv_evb/rtl8752htv_evb_defconfig
```kconfig
# Copyright (c) 2024 Realtek Semiconductor Corp.
# SPDX-License-Identifier: Apache-2.0

# CONFIG_SOC_SERIES_RTL8752H=y
# CONFIG_SOC_RTL8752HTV=y
# CONFIG_BOARD_RTL8752HTV_EVB=y

# DISASSEMBLY
CONFIG_OUTPUT_DISASSEMBLY=y

# link application into the flash partition selected by the zephyr,code-partition property in /chosen in devicetree
CONFIG_USE_DT_CODE_PARTITION=y
CONFIG_CODE_DATA_RELOCATION=y
CONFIG_REALTEK_BT_CONTROLLER_STACK_SIZE=2560
# Save DataRAM for APP


# For Debug
CONFIG_DEBUG_OPTIMIZATIONS=y
CONFIG_SYS_HEAP_RUNTIME_STATS=y

CONFIG_MULTI_HEAP=y

CONFIG_PINCTRL=y
CONFIG_CLOCK_CONTROL=y

# Console Driver
CONFIG_CONSOLE=y
CONFIG_UART_CONSOLE=y

# UART Driver
CONFIG_SERIAL=y
CONFIG_UART_INTERRUPT_DRIVEN=y
# CONFIG_UART_ASYNC_API=y

# Logging
CONFIG_LOG_BACKEND_SHOW_COLOR=n
CONFIG_LOG_FUNC_NAME_PREFIX_INF=y
CONFIG_LOG_FUNC_NAME_PREFIX_WRN=y
CONFIG_LOG_FUNC_NAME_PREFIX_ERR=y

# nmi
CONFIG_RUNTIME_NMI=y

CONFIG_TICKLESS_KERNEL=n
CONFIG_TIMESLICE_SIZE=10

CONFIG_DEBUG_THREAD_INFO=y
CONFIG_THREAD_MONITOR=y
CONFIG_IDLE_STACK_SIZE=512
```

## app/boards/arm/rtl8762gku_kb/Kconfig.defconfig
```kconfig
# Copyright (c) 2024 Realtek Semiconductor Corp.
# SPDX-License-Identifier: Apache-2.0
if BOARD_RTL8762GKU

config BOARD
    default "rtl8762gku"

endif #BOARD_RTL8762GKU
```

## app/boards/arm/rtl8762gku_kb/rtl8762gku_kb_defconfig
```kconfig
# Console Driver
CONFIG_CONSOLE=y
CONFIG_UART_CONSOLE=y

CONFIG_SERIAL=y
CONFIG_UART_INTERRUPT_DRIVEN=y

# trustzone related
CONFIG_TRUSTED_EXECUTION_SECURE=y
CONFIG_ARM_SECURE_BUSFAULT_HARDFAULT_NMI=y

# BT Setting for rtl87x2g SoC series
CONFIG_REALTEK_BT=y
CONFIG_BT_CTLR=n
CONFIG_COMMON_LIBC_MALLOC_ARENA_SIZE=1024
CONFIG_BT_BUF_EVT_RX_COUNT=8
CONFIG_BT_BUF_EVT_RX_SIZE=255
CONFIG_BT_BUF_ACL_TX_SIZE=251
# # L2CAP SDU/PDU TX MTU
CONFIG_BT_L2CAP_TX_MTU=247
# # The minimum value for this is
# # L2AP MPS + L2CAP header (4)
CONFIG_BT_BUF_ACL_RX_SIZE=255
CONFIG_BT_BUF_ACL_RX_COUNT=7

# Resolve stack overflow issues
CONFIG_MAIN_STACK_SIZE=2048

CONFIG_OUTPUT_DISASSEMBLY=y

# Enable HW stack protection
CONFIG_HW_STACK_PROTECTION=y
```

## app/boards/arm/rtl8762gn_evb/Kconfig.defconfig
```kconfig
# Copyright (c) 2024 Realtek Semiconductor Corp.
# SPDX-License-Identifier: Apache-2.0
if BOARD_RTL8762GN_EVB

config BOARD
	default "rtl8762gn_evb"

if BT

config MAIN_STACK_SIZE
	default 2048

config COMMON_LIBC_MALLOC_ARENA_SIZE
	default 1024

config BT_CTLR
	default n

config REALTEK_BT
	default y

config BT_L2CAP_TX_MTU
	default 247
	
config BT_BUF_EVT_RX_COUNT
	default 8

config BT_BUF_EVT_RX_SIZE
	default 255

config BT_BUF_ACL_TX_SIZE
	default 251

config BT_BUF_ACL_RX_SIZE
	default 255

config BT_BUF_ACL_RX_COUNT
	default 7

endif # BT

endif #BOARD_RTL8762GN_EVB
```

## app/boards/arm/rtl8762gtu_kb/Kconfig.defconfig
```kconfig
if BOARD_RTL8762GKU

config BOARD
    default "rtl8762gku"

config REALTEK_BT
    default y

endif #BOARD_RTL8762GKU
```

## app/boards/arm/rtl8762gtu_kb/Kconfig.rtl8762gtu_kb
```kconfig
# Copyright (c) 2024 Realtek Semiconductor Corp.
# SPDX-License-Identifier: Apache-2.0
config BOARD_RTL8762GTU_KB
    select SOC_RTL8762GTU
```

## app/boards/shields/realtek_rcu/Kconfig.defconfig
```kconfig
# Copyright (c) 2024
# SPDX-License-Identifier: MIT

if SHIELD_REALTEK_RCU

config ZMK_RCU_NAME
    default "Realtek Rcu"

endif
```

## app/boards/shields/realtek_rcu/Kconfig.shield
```kconfig
# Copyright (c) 2024
# SPDX-License-Identifier: MIT

config SHIELD_REALTEK_RCU
    def_bool $(shields_list_contains,realtek_rcu)
```

## app/boards/shields/rtk_keyboard_bee3plus/Kconfig.defconfig
```kconfig
# Copyright (c) 2024
# SPDX-License-Identifier: MIT

if SHIELD_RTK_KEYBOARD_BEE3PLUS

config ZMK_KEYBOARD_NAME
    default "RTK_KEYBOARD"

endif
```

## app/boards/shields/rtk_keyboard_bee3plus/Kconfig.shield
```kconfig
# Copyright (c) 2024
# SPDX-License-Identifier: MIT

config SHIELD_RTK_KEYBOARD_BEE3PLUS
    def_bool $(shields_list_contains,rtk_keyboard_bee3plus)
```
