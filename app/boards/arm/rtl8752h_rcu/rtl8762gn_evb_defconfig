## app/boards/arm/rtl8752h_rcu/rtl8762gn_evb_defconfig
```kconfig
CONFIG_SOC_SERIES_RTL87X2G=y
CONFIG_BOARD_RTL8762GN_EVB=y
CONFIG_SOC_RTL8762GN=y

CONFIG_CLOCK_CONTROL=y
CONFIG_PINCTRL=y
CONFIG_DYNAMIC_INTERRUPTS=y

CONFIG_CONSOLE=y
CONFIG_UART_CONSOLE=y

CONFIG_SERIAL=y
CONFIG_UART_INTERRUPT_DRIVEN=y
# CONFIG_UART_ASYNC_API=y

CONFIG_TICKLESS_KERNEL=n
CONFIG_TIMESLICE_SIZE=10
CONFIG_INIT_STACKS=y
CONFIG_FPU=y
CONFIG_XIP=y

# trustzone related
CONFIG_TRUSTED_EXECUTION_NONSECURE=n
CONFIG_TRUSTED_EXECUTION_SECURE=y
CONFIG_ARM_SECURE_BUSFAULT_HARDFAULT_NMI=y

# for srand()
CONFIG_MINIMAL_LIBC=y
CONFIG_MINIMAL_LIBC_RAND=y

# place vector table and ISR code to RAM to avoid hardfault triggered by flash-suspend
CONFIG_CODE_DATA_RELOCATION=y
CONFIG_LINKER_USE_BOOT_SECTION=y

# BT Setting for rtl87x2g SoC series
CONFIG_REALTEK_BT=y
CONFIG_BT_HCI=y
CONFIG_BT_CTLR=n
CONFIG_BT_RECV_BLOCKING=y
CONFIG_COMMON_LIBC_MALLOC_ARENA_SIZE=1024
CONFIG_BT_BUF_EVT_RX_COUNT=8
CONFIG_BT_BUF_EVT_RX_SIZE=255
CONFIG_BT_BUF_ACL_TX_SIZE=251
# L2CAP SDU/PDU TX MTU
CONFIG_BT_L2CAP_TX_MTU=247
# The minimum value for this is
# L2AP MPS + L2CAP header (4)
CONFIG_BT_BUF_ACL_RX_SIZE=255
CONFIG_BT_BUF_ACL_RX_COUNT=7
CONFIG_BT_HOST_CRYPTO_PRNG=n

# Resolve stack overflow issues
CONFIG_MAIN_STACK_SIZE=2048

CONFIG_OUTPUT_DISASSEMBLY=y

# speed up the code execution
CONFIG_SPEED_OPTIMIZATIONS=y

# link application into the the flash partition selected by the zephyr,code-partition property in /chosen in devicetree
CONFIG_USE_DT_CODE_PARTITION=y
```

## app/boards/arm/rtl8752htv_evb/Kconfig.board
```kconfig
config BOARD_RTL8752HTV_EVB
	bool "RealTek rtl8752htv evaluation board"
	depends on SOC_SERIES_RTL8752H
	select SOC_PART_NUMBER_RTL8752HTV
```

## app/boards/arm/rtl8762gn_evb/Kconfig.board
```kconfig
config BOARD_RTL8762GN_EVB
	bool "RealTek rtl8762gn evaluation board"
	depends on SOC_SERIES_RTL87X2G
	select SOC_PART_NUMBER_RTL8762GN
```

## app/boards/arm/rtl8762gn_evb/rtl8762gn_evb_defconfig
```kconfig
CONFIG_SOC_SERIES_RTL87X2G=y
CONFIG_BOARD_RTL8762GN_EVB=y
CONFIG_SOC_RTL8762GN=y

CONFIG_CLOCK_CONTROL=y
CONFIG_PINCTRL=y
CONFIG_DYNAMIC_INTERRUPTS=y

CONFIG_CONSOLE=y
CONFIG_UART_CONSOLE=y

CONFIG_SERIAL=y
CONFIG_UART_INTERRUPT_DRIVEN=y
# CONFIG_UART_ASYNC_API=y

CONFIG_TICKLESS_KERNEL=n
CONFIG_TIMESLICE_SIZE=10
CONFIG_INIT_STACKS=y
CONFIG_FPU=y
CONFIG_XIP=y

# trustzone related
CONFIG_TRUSTED_EXECUTION_NONSECURE=n
CONFIG_TRUSTED_EXECUTION_SECURE=y
CONFIG_ARM_SECURE_BUSFAULT_HARDFAULT_NMI=y

# for srand()
CONFIG_MINIMAL_LIBC=y
CONFIG_MINIMAL_LIBC_RAND=y

# place vector table and ISR code to RAM to avoid hardfault triggered by flash-suspend
CONFIG_CODE_DATA_RELOCATION=y
CONFIG_LINKER_USE_BOOT_SECTION=y


# BT Setting for rtl87x2g SoC series
# CONFIG_BT_HCI=y
# CONFIG_BT_CTLR=n
# CONFIG_BT_RECV_BLOCKING=y
# CONFIG_COMMON_LIBC_MALLOC_ARENA_SIZE=1024

# Resolve stack overflow issues
CONFIG_MAIN_STACK_SIZE=2048
```

## app/boards/arm/rtl8762gtu_kb/Kconfig.board
```kconfig
config BOARD_RTL8762GTU
	bool "RealTek rtl8762gtu board"
	depends on SOC_SERIES_RTL87X2G
	select SOC_PART_NUMBER_RTL8762GTU
```

## app/boards/arm/rtl8772gwp_evb/Kconfig.board
```kconfig
config BOARD_RTL8772GWP
	bool "RealTek rtl8772gwp board"
	depends on SOC_SERIES_RTL87X2G
	select SOC_PART_NUMBER_RTL8772GWP
```

## app/boards/arm/rtl8772gwp_evb/Kconfig.defconfig
```kconfig
if BOARD_RTL8772GWP

config BOARD
	default "rtl8772gwp"

endif #BOARD_RTL8772GWP
```

## app/boards/shields/rtk_keyboard/Kconfig.defconfig
```kconfig
# Copyright (c) 2024
# SPDX-License-Identifier: MIT

if SHIELD_RTK_KEYBOARD

config ZMK_KEYBOARD_NAME
    default "RTK_KEYBOARD"

endif
```

## app/boards/shields/rtk_keyboard/Kconfig.shield
```kconfig
# Copyright (c) 2024
# SPDX-License-Identifier: MIT

config SHIELD_RTK_KEYBOARD
    def_bool $(shields_list_contains,rtk_keyboard)
```

## app/boards/shields/rtk_keyboard_evb/Kconfig.defconfig
```kconfig
# Copyright (c) 2024
# SPDX-License-Identifier: MIT

if SHIELD_RTK_KEYBOARD_EVB

config ZMK_KEYBOARD_NAME
    default "BLE_KEYBOARD"

endif
```

## app/boards/shields/rtk_keyboard_evb/Kconfig.shield
```kconfig
# Copyright (c) 2024
# SPDX-License-Identifier: MIT

config SHIELD_RTK_KEYBOARD_EVB
    def_bool $(shields_list_contains,rtk_keyboard_evb)
```

## app/dts/bindings/ppt/zmk,ppt-node.yaml
```yaml
# Copyright (c) 2020, The ZMK Contributors
# SPDX-License-Identifier: MIT

description: |
  RTL87X2G PPT.
compatible: "zmk,ppt-node"

include: [base.yaml]

properties:
  enh-timers:
    type: phandles
    required: true
    description: |
      timer8 and timer9 will be used by ppt.
```

## app/dts/bindings/zmk,gpio-leds-all.yaml
```yaml
#
# Copyright (c) 2019 Nordic Semiconductor ASA
#
# SPDX-License-Identifier: Apache-2.0
#

description: |
    Allows defining the collection of gpio leds in ZMK.

compatible: "zmk,gpio-leds-all"

properties:
  pwr-gpios:
    type: phandle-array
    required: true

  cap-gpios:
    type: phandle-array
    required: true

  num-gpios:
    type: phandle-array
    required: true

  ble-gpios:
    type: phandle-array
    required: true

  ppt-gpios:
    type: phandle-array
    required: true

  other-gpios:
    type: phandle-array
    required: true
```

## app/dts/bindings/zmk,mode-monitor-pin.yaml
```yaml
#
# Copyright (c) 2019 Nordic Semiconductor ASA
#
# SPDX-License-Identifier: Apache-2.0
#

description: |
    Allows defining the collection of mode monitor pins in ZMK.

compatible: "zmk,mode-monitor-pin"

properties:
  ble-gpios:
    type: phandle-array
    required: true

  ppt-gpios:
    type: phandle-array
    required: true
```

## app/west.yml
```yaml
manifest:
  remotes:
    - name: zephyrproject-rtos
      url-base: https://github.com/zephyrproject-rtos
    - name: rtkconnectivity
      url-base: https://github.com/rtkconnectivity
  projects:
    - name: zephyr
      remote: rtkconnectivity
      revision: realtek-main-v3.5.0
      clone-depth: 1
      import:
        name-blocklist:
          - ci-tools
          - hal_altera
          - hal_cypress
          - hal_infineon
          - hal_microchip
          - hal_nxp
          - hal_openisa
          - hal_silabs
          - hal_xtensa
          - hal_st
          - hal_ti
          - hal_ambiq
          - hal_atmel
          - hal_espressif
          - hal_ethos_u
          - hal_gigadevice
          - hal_intel
          - hal_nordic
          - hal_nuvoton
          - hal_quicklogic
          - hal_renesas
          - hal_rpi_pico
          - hal_telink
          - hal_wurthelektronik
          - hal_stm32
          - cmsis-dsp
          - cmsis-nn
          - fatfs
          - loramac-node
          - mcuboot
          - mcumgr
          - net-tools
          - openthread
          - edtt
          - trusted-firmware-m
  self:
    west-commands: scripts/west-commands.yml
```
