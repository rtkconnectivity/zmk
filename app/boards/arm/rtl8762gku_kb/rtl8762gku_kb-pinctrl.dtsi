/*
 * Copyright(c) 2020, Realtek Semiconductor Corporation.
 * SPDX-License-Identifier: Apache-2.0
 */

 #include <dt-bindings/pinctrl/bee-pinctrl.h>

&pinctrl {
    uart2_default: uart2_default {
        group1 {
            psels = <BEE_PSEL(UART2_TX, P3_0, DIR_OUT, DRV_HIGH, PULL_UP)>,
            <BEE_PSEL(UART2_RX, P3_3, DIR_IN, DRV_HIGH, PULL_UP)>;
        };
    };
};

